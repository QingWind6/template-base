## main/Kconfig.projbuild
```kconfig
menu "Template Base Board"

choice BOARD_TYPE
    prompt "Board type"
    default BOARD_NEW_BOARD

    config BOARD_NEW_BOARD
        bool "new_board"
endchoice

config BOARD_NAME
    string
    default "new_board" if BOARD_NEW_BOARD

endmenu
```

## sdkconfig.defaults
```kconfig
CONFIG_IDF_TARGET="esp32s3"
CONFIG_ESPTOOLPY_FLASHSIZE_8MB=y
CONFIG_PARTITION_TABLE_CUSTOM=y
CONFIG_PARTITION_TABLE_CUSTOM_FILENAME="partitions_8mb.csv"
CONFIG_PARTITION_TABLE_FILENAME="partitions_8mb.csv"
CONFIG_APP_PROJECT_VER="0.1.0"
CONFIG_COMPILER_CXX_EXCEPTIONS=y
```
